## hello_world/west.yml
```yaml
manifest:
  remotes:
    - name: zephyrproject
      url-base: https://github.com/zephyrproject-rtos
  defaults:
    remote: zephyrproject

  projects:
    # Zephyr repository (specific tag or branch)
    - name: zephyr
      path: zephyr
      revision: v4.3.0
      import: true  # Pull in Zephyr modules automatically
    - name: tflite-micro
      revision: 8d404de73acf7687831e16d88e86e4f73cfddf8e
      path: modules/lib/tflite-micro

  self:
    path: .
```
